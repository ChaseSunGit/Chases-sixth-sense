/**
 * \file        MPU6050_MF3000.cpp
 * \brief       Library for interfacing with MPU6050.
 *
 * \authors     Chase Sun
 * \bug
 */

// INCLUDES
#include "MPU6050_MF3000.h"

//GLOBAL VARIABLES
IMUData IMU_Data_Holder[NUM_IMUS];//The holder for IMU information. This declaration zeros all fields

bool IMU_first_read = true;

uint32_t lastMicros;//Used to time the kalman filter


// FUNCTIONS

/**
 * \brief Tool to write I2C command to a register of a specific ID
 *
 * \param IMU_ID //ID of IMU
 * \param reg //The i2c register to write to
 * \param data //The data to write to
 * \return
 */
void mpuWrite(int IMU_ID, uint8_t reg, uint8_t data) {
        //First check if IMU_ID is valid
        if (IMU_ID < 0 || IMU_ID > ((int)NUM_IMUS-1)){
                return;//Just return fail read if the ID is not valid
        }
        IMU_Data_Holder[IMU_ID].i2cBus->beginTransmission(IMU_Data_Holder[IMU_ID].addr);
        IMU_Data_Holder[IMU_ID].i2cBus->write(reg);
        IMU_Data_Holder[IMU_ID].i2cBus->write(data);
        IMU_Data_Holder[IMU_ID].i2cBus->endTransmission(true); // We will free the wire every time we communicate. Its a bit slower
}


/**
 * \brief Tool to read I2C register. This only reads 1 register for checking config. Do not use this to read actual Accel/Gyro data as its too slow
 *
 * \param IMU_ID //ID of IMU
 * \param reg //The i2c register to write to
 * \return
 */
uint8_t mpuRead(int IMU_ID, uint8_t reg) {
        //First check if IMU_ID is valid
        if (IMU_ID < 0 || IMU_ID > ((int)NUM_IMUS-1)){
                return 0;//Just return fail read if the ID is not valid
        }
        
        IMU_Data_Holder[IMU_ID].i2cBus->beginTransmission(IMU_Data_Holder[IMU_ID].addr);
        IMU_Data_Holder[IMU_ID].i2cBus->write(reg);
        IMU_Data_Holder[IMU_ID].i2cBus->endTransmission(false);          // repeated START
        IMU_Data_Holder[IMU_ID].i2cBus->requestFrom((uint8_t)IMU_Data_Holder[IMU_ID].addr,(size_t)1,true);
        return IMU_Data_Holder[IMU_ID].i2cBus->read();
}


/**
 * \brief Function to initialize a single MPU6050 IMU
 *
 * \param IMU_ID the ID of the IMU. 0 = back, 1 = shank_L, 2 = thigh_L, 3 = shank_R, 4 = thigh_R
 * \param reportFreqnency the frequency to report data. If ran in IMU mode, this determines the frequency of the control loop
 * \return boolean value true meaning successfully initialized and false failed
 */
bool initMPU6050(int IMU_ID, int reportFrequency) {
        //First we initialze the struct and set ID and wire
        IMU_Data_Holder[IMU_ID].valid_flag = 0;//assume imu is not used
        switch(IMU_ID){
                case 0://Back
                        IMU_Data_Holder[IMU_ID].addr = 0x68;
                        IMU_Data_Holder[IMU_ID].i2cBus = &Wire2;
                        IMU_Data_Holder[IMU_ID].ax_offset = 0.2055;//These are factory offsets generated by the accel factory calibration function. Update when IMU is swapped
                        IMU_Data_Holder[IMU_ID].ay_offset = -0.1605;
                        IMU_Data_Holder[IMU_ID].az_offset = -0.4815;
                        break;
                case 1://L_shank
                        IMU_Data_Holder[IMU_ID].addr = 0x68;
                        IMU_Data_Holder[IMU_ID].i2cBus = &Wire;
                        IMU_Data_Holder[IMU_ID].ax_offset = 0.5080;
                        IMU_Data_Holder[IMU_ID].ay_offset = -0.0664;
                        IMU_Data_Holder[IMU_ID].az_offset = -0.8728;
                        break;
                case 2://L_thigh
                        IMU_Data_Holder[IMU_ID].addr = 0x69;
                        IMU_Data_Holder[IMU_ID].i2cBus = &Wire;
                        IMU_Data_Holder[IMU_ID].ax_offset = 0.5588;
                        IMU_Data_Holder[IMU_ID].ay_offset = -0.2993;
                        IMU_Data_Holder[IMU_ID].az_offset = -1.9507;
                        break;
                case 3://R_shank
                        IMU_Data_Holder[IMU_ID].addr = 0x68;
                        IMU_Data_Holder[IMU_ID].i2cBus = &Wire1;
                        IMU_Data_Holder[IMU_ID].ax_offset = 0.6235;
                        IMU_Data_Holder[IMU_ID].ay_offset = -0.1981;
                        IMU_Data_Holder[IMU_ID].az_offset = -0.5766;
                        break;
                case 4://R_thigh
                        IMU_Data_Holder[IMU_ID].addr = 0x69;
                        IMU_Data_Holder[IMU_ID].i2cBus = &Wire1;
                        IMU_Data_Holder[IMU_ID].ax_offset = 0.5544;
                        IMU_Data_Holder[IMU_ID].ay_offset = 0.0599;
                        IMU_Data_Holder[IMU_ID].az_offset = -1.3322;
                        break;
                default://Invalid
                        return 0;
        }

        //For configuration, we do 7 steps
        //1. Set power mode to 1 - clock source x gyro and wakes up MPU
        //2. set filter bandwidth - 44hz default
        //3. Set divider for reporting frequency - 200 hz default, controls the low level control loop speed if IMU mode is enabled
        //4. Set accel range - 8g default
        //5. Set gyro range - 500deg default
        //6. Check if the IMU id is what we expect - this checks if there is a valid connection to the IMU after all configuration
        //7. Set the valid flag in IMU data struct to 1 so that its data can be streamed.


        mpuWrite(IMU_ID, PWR_MGMT_1,    0x01); // 0x01 - Wake, 0x40 - sleep, 0x80 - reset
        mpuWrite(IMU_ID, CONFIG,        0x03); // 0x00 - disable DLPF and sample 8kHz, 0x03 - DLPF BW 44Hz, 0x04 - DLPF BW 21Hz 
        mpuWrite(IMU_ID, SMPLRT_DIV,    0x04); // 0x00 - 1000Hz, 0x01 - 500Hz, 0x02 - 333Hz, 0x04 - 200Hz
        mpuWrite(IMU_ID, ACCEL_CONFIG,  0x10); // 0x00 - 2g (16384sense), 0x08 - 4g (8192sense), 0x10 - 8g (4096sense), 0x18 - 16g (2048sense)
        mpuWrite(IMU_ID, GYRO_CONFIG,   0x08); // 0x00 - 250deg (131sense), 0x08 - 500 deg (65.5sense), 0x10 - 1000 deg (32.8sense), 0x18 - 2000 deg (16.4sense)

        uint8_t check_addr = mpuRead(IMU_ID, WHO_AM_I);
        if (check_addr != 0x68){

                Serial.printf("Wrong address on IMU %d! Address found to be %x, address we are looking for is %x\n", IMU_ID, check_addr, IMU_Data_Holder[IMU_ID].addr);
                return false; //Checking who am I failed, IMU not initialized
        }

        IMU_Data_Holder[IMU_ID].valid_flag = 1;//Mark that the IMU is valid and in use

        //Last step: set the kalman filter parameters (defaults used)
        IMU_Data_Holder[IMU_ID].kalmanRoll.setQangle(0.001);
        IMU_Data_Holder[IMU_ID].kalmanRoll.setQbias(0.003);
        IMU_Data_Holder[IMU_ID].kalmanRoll.setRmeasure(0.03);

        IMU_Data_Holder[IMU_ID].kalmanPitch.setQangle(0.001);
        IMU_Data_Holder[IMU_ID].kalmanPitch.setQbias(0.003);
        IMU_Data_Holder[IMU_ID].kalmanPitch.setRmeasure(0.03);

        return true;
}

/**
 * \brief Function to initialize all IMUs. If an IMU is not active, it will be marked down and not used.
 * \param reportFrequency The report rate of imus which controls clock rate of the low level controller
 * \return nothing
 */
 void mpu6050_bulk_initialization(int reportFrequency){
        for (int i = 0; i < (int)NUM_IMUS; i++){//The forloop initializes all 5 IMUs. It is fine if IMUs are not used, the code will just mark them invalid and skip them in reading data
                if(initMPU6050(i,reportFrequency) == 0){Serial.printf("Failed to initialize IMU %d. Marked disabled, skipping\n", i);}
                else{Serial.printf("IMU %d initialized with frequency %d\n", i, reportFrequency);}
        }
 }

/**
 * \brief enables the back imu interrupt on bus 2 and uses it as a source for the clock signal of the control loop
 *
 * \param IMU_ID the ID of the IMU that is being used as a clock. Default is back ID = 0
 * \return void
 */
 bool enable_IMU_interrupt(int IMU_ID) {
        //First check if IMU_ID is valid
        if (IMU_ID < 0 || IMU_ID > ((int)NUM_IMUS-1)){
                return 0;//Just return fail read if the ID is not valid
        }
        // INT_ENABLE register = 0x38
        mpuWrite(IMU_ID, INT_ENABLE, 0x01); // 0x01 for enable, 0x00 for disable
        
        return 1;
}

/**
 * \brief Function to calibrate the gyroscope of all sensors simutaniously. The function populates the gx_offset, gy_offset, and gz_offset data fields in the imu struct
 * takes advantage of the interrupt and ISR to time reads. Calibrates all online sensors at once
 * \param num_samples the number of samples to average. Default 400
 * \param interrupt the ISR boolean used as a clock
 * \return nothing
 */
 void mpu6050_bulk_calibration(int num_samples, volatile bool& interrupt){
        int sample_count = 0;
        while (sample_count < num_samples){
                if (interrupt){
                        //Interrupt triggered, count the loop
                        interrupt = false;//reset int
                        sample_count ++;
                        read_all_imus(true);//read all available imus, calibration mode is set to true
                        //The offset terms should accumilate
                }
        }
        //Now that the requsite samples are collected, average the offsets
        for (int i = 0; i < (int)NUM_IMUS; i++){
                if (IMU_Data_Holder[i].valid_flag == true){
                        IMU_Data_Holder[i].gx_offset = IMU_Data_Holder[i].gx_offset/((float)sample_count);
                        IMU_Data_Holder[i].gy_offset = IMU_Data_Holder[i].gy_offset/((float)sample_count);
                        IMU_Data_Holder[i].gz_offset = IMU_Data_Holder[i].gz_offset/((float)sample_count);
                        Serial.printf("IMU %d gyro offsets: x: %.4f, y: %.4f, z: %.4f\n", i, IMU_Data_Holder[i].gx_offset,IMU_Data_Holder[i].gy_offset,IMU_Data_Holder[i].gz_offset);    
                }
        }
        Serial.println("Calibration complete!");
 }

/**
 * \brief Function to read IMU data with low level i2c code. The reason why adafruit's getEvent is not used is because it is too slow due to it reading multiple i2c registers to find out imu settings for calcuation
 *When the function is completed, the imu data struct will be populated with the most recent data
 * \param IMU_ID the id of the imu
 * \param calibrationMode boolean to select if gyroscope is in calibration. Default is false and only choose true if in initial calibration step.
 * \return boolean whether read was successful
 */
 bool mpu6050_read_accel_gyro_lightweight(int IMU_ID, bool calibrationMode){
        //First check if IMU_ID is valid
        if (IMU_ID < 0 || IMU_ID > ((int)NUM_IMUS-1)){
                return 0;//Just return fail read if the ID is not valid
        }
        //First check if IMU is actually initialized
        if (IMU_Data_Holder[IMU_ID].valid_flag == false){
                return 0;//Just return fail read if the IMU is not being used
        }

        // Burst read 14 bytes starting at ACCEL_XOUT_H (0x3B)
        const uint8_t START_REG = 0x3B;
        uint8_t buf[14];

        IMU_Data_Holder[IMU_ID].i2cBus->beginTransmission(IMU_Data_Holder[IMU_ID].addr);
       
        IMU_Data_Holder[IMU_ID].i2cBus->write(START_REG);

        IMU_Data_Holder[IMU_ID].i2cBus->endTransmission(false);
        //if (IMU_Data_Holder[IMU_ID].i2cBus->requestFrom(IMU_Data_Holder[IMU_ID].addr, (uint8_t)14) != 14) return false;
        
        IMU_Data_Holder[IMU_ID].i2cBus->requestFrom(static_cast<uint8_t>(IMU_Data_Holder[IMU_ID].addr),static_cast<size_t>(14),true);
        //IMU_Data_Holder[IMU_ID].i2cBus->requestFrom(IMU_Data_Holder[IMU_ID].addr, 14, true);

        for (int i = 0; i < 14; ++i) buf[i] = IMU_Data_Holder[IMU_ID].i2cBus->read();

        // Unpack raw 16-bit values
        int16_t ax_raw = (int16_t)((buf[0]  << 8) | buf[1]);
        int16_t ay_raw = (int16_t)((buf[2]  << 8) | buf[3]);
        int16_t az_raw = (int16_t)((buf[4]  << 8) | buf[5]);
        // int16_t temp_raw = (int16_t)((buf[6]  << 8) | buf[7]); // optional
        int16_t gx_raw = (int16_t)((buf[8]  << 8) | buf[9]);
        int16_t gy_raw = (int16_t)((buf[10] << 8) | buf[11]);
        int16_t gz_raw = (int16_t)((buf[12] << 8) | buf[13]);

        // --- Conversion constants (match your configured ranges) ---
        // Accel LSB per g: ±2g=16384, ±4g=8192, ±8g=4096, ±16g=2048
        const float ACCEL_LSB_PER_G = 4096.0f;     // for ±8g
        const float GYRO_LSB_PER_DPS = 65.5f;      // for ±500 dps
        const float G = 9.80665f;

        
        //Make distinction in calibration mode
        if (calibrationMode){
                //If we are calibrating - should not be the case during normal operation
                //We will accumilate the measurements in the calibration field to be averaged later
                IMU_Data_Holder[IMU_ID].gx = gx_raw / GYRO_LSB_PER_DPS;
                IMU_Data_Holder[IMU_ID].gy = gy_raw / GYRO_LSB_PER_DPS;
                IMU_Data_Holder[IMU_ID].gz = gz_raw / GYRO_LSB_PER_DPS;

                IMU_Data_Holder[IMU_ID].ax = (ax_raw / ACCEL_LSB_PER_G) * G;
                IMU_Data_Holder[IMU_ID].ay = (ay_raw / ACCEL_LSB_PER_G) * G;
                IMU_Data_Holder[IMU_ID].az = (az_raw / ACCEL_LSB_PER_G) * G;

                IMU_Data_Holder[IMU_ID].gx_offset += IMU_Data_Holder[IMU_ID].gx;
                IMU_Data_Holder[IMU_ID].gy_offset += IMU_Data_Holder[IMU_ID].gy;
                IMU_Data_Holder[IMU_ID].gz_offset += IMU_Data_Holder[IMU_ID].gz;
        }
        else{
                //Not in calibration mode, we either have valid constants or they are zero, subtract regardless
                IMU_Data_Holder[IMU_ID].gx = gx_raw / GYRO_LSB_PER_DPS - IMU_Data_Holder[IMU_ID].gx_offset;
                IMU_Data_Holder[IMU_ID].gy = gy_raw / GYRO_LSB_PER_DPS - IMU_Data_Holder[IMU_ID].gy_offset;
                IMU_Data_Holder[IMU_ID].gz = gz_raw / GYRO_LSB_PER_DPS - IMU_Data_Holder[IMU_ID].gz_offset;

                IMU_Data_Holder[IMU_ID].ax = (ax_raw / ACCEL_LSB_PER_G) * G - IMU_Data_Holder[IMU_ID].ax_offset;//Apply hardcoded factory offset
                IMU_Data_Holder[IMU_ID].ay = (ay_raw / ACCEL_LSB_PER_G) * G - IMU_Data_Holder[IMU_ID].ay_offset;
                IMU_Data_Holder[IMU_ID].az = (az_raw / ACCEL_LSB_PER_G) * G - IMU_Data_Holder[IMU_ID].az_offset;
        }



        return true;
}


/**
 * \brief Function to read all IMUs at once. If an IMU is not active, the function simply does not populate the data field of the struct.
 *This function should be called when ISR is triggered. This is a non-blocking read in the sense that it will read whatever data is available in the IMU data registers no matter new or old. Therefore, it can be called at any frequency independent of the IMU sample rate. However, the read speed limited by i2c speed are listed below
 *| I2C HS       |400,000|       |0.4 ms per read|       |2 ms total|
 *| I2C HS+      |1,000,000|     |0.2 ms per read|       |1 ms total|
 *| I2C LS       |100,000|       |2.0 ms per read|       |10 ms total|
 * \param calibrationMode boolean to select if gyroscope is in calibration. Default is false and only choose true if in initial calibration step.

 * \return nothing
 */
 void read_all_imus(bool calibrationMode){
        for (int i = 0; i < (int)NUM_IMUS; i++){
                mpu6050_read_accel_gyro_lightweight(i,calibrationMode);
        }
}

/**
 * \brief Function to perform Kalman filtering of a single IMU. Populates the Euler angle fields of the IMU struct
 * the function will only perform kalman filtering if IMU is active
 * \param IMU_ID the id of the imu
 * \param dt the time elapsed from the last read for gyro integration
 * \return nothing
 */
 void Kalman_single_imu(int IMU_ID, float dt){
        //First compute basic roll and pitch angles with accel only

        float rollAcc  = atan2(IMU_Data_Holder[IMU_ID].ay, IMU_Data_Holder[IMU_ID].az) * RAD_TO_DEG;
        float pitchAcc = atan2(-IMU_Data_Holder[IMU_ID].ax, sqrt(IMU_Data_Holder[IMU_ID].ay * IMU_Data_Holder[IMU_ID].ay + IMU_Data_Holder[IMU_ID].az * IMU_Data_Holder[IMU_ID].az)) * RAD_TO_DEG;
        
        if(IMU_first_read){
                IMU_Data_Holder[IMU_ID].kalmanRoll.setAngle(rollAcc);
                IMU_Data_Holder[IMU_ID].kalmanPitch.setAngle(pitchAcc);
                IMU_Data_Holder[IMU_ID].roll = rollAcc;
                IMU_Data_Holder[IMU_ID].pitch = pitchAcc; //If first reading, the roll and pitch will be purely based on accelerometer.
                //The first read boolean can also be held true to disable the kalman filter for debugging
                return;
        }
        //Now that first read is over, we actually engage the kalman filter
        
        //First, calculate the time difference between the two reads
        
        IMU_Data_Holder[IMU_ID].roll = IMU_Data_Holder[IMU_ID].kalmanRoll.getAngle(rollAcc, IMU_Data_Holder[IMU_ID].gx, dt);

        IMU_Data_Holder[IMU_ID].pitch = IMU_Data_Holder[IMU_ID].kalmanPitch.getAngle(pitchAcc, IMU_Data_Holder[IMU_ID].gy, dt);

 }        
        

/**
 * \brief Function to kalman filter all available IMUs
 * \return nothing
 */
 void Kalman_batch_imu(){
        uint32_t currentMicros = micros();
        float dt = (currentMicros - lastMicros) * 1e-6;
        Serial.printf("dt %.8f\n",dt);
        lastMicros = currentMicros;

        for (int i = 0; i < (int)NUM_IMUS; i++){
                Kalman_single_imu(i,dt);
        }
        IMU_first_read = false;//Only triggers once after the first read. Remove this line to disable kalman filter and only use accel for roll/pitch
 }

/**
 * \brief Function to factory calibrate accelerometer. Should only be called in a standalone script and should not be ran during regular operation
 * It generates 
 * \param IMU_ID id of the IMU to be calibrated. Only do this one at a time as IMU needs to be perfectly flat
 * \param num_samples the number of samples to average. Default 400
 * \param interrupt the ISR boolean used as a clock
 * \return nothing
 */
 void mpu6050_factory_accel_calibration(int IMU_ID, int num_samples, volatile bool& interrupt){
        //First check if IMU_ID is valid
        if (IMU_ID < 0 || IMU_ID > ((int)NUM_IMUS-1)){
                return;//Just return fail read if the ID is not valid
        }
        //First check if IMU is actually initialized
        if (IMU_Data_Holder[IMU_ID].valid_flag == false){
                return;//Just return fail read if the IMU is not being used
        }
        
        Serial.printf("IMU %d accel calibration beginning in 3 seconds. Keep it flat and face up\n",IMU_ID);
        delay(1000);
        Serial.printf("IMU %d accel calibration beginning in 2 seconds. Keep it flat and face up\n",IMU_ID);
        delay(1000);
        Serial.printf("IMU %d accel calibration beginning in 1 seconds. Keep it flat and face up\n",IMU_ID);
        delay(1000);
        Serial.printf("IMU %d accel calibration beginning now!\n",IMU_ID);
        IMU_Data_Holder[IMU_ID].ax_offset = 0;
        IMU_Data_Holder[IMU_ID].ay_offset = 0;
        IMU_Data_Holder[IMU_ID].az_offset = 0;//Zero all offsets to generate new set
        int sample_count = 0;
        while (sample_count < num_samples){
                if (interrupt){
                        //Interrupt triggered, count the loop
                        interrupt = false;//reset int
                        sample_count ++;
                        mpu6050_read_accel_gyro_lightweight(IMU_ID,true);
                        IMU_Data_Holder[IMU_ID].ax_offset += IMU_Data_Holder[IMU_ID].ax;
                        IMU_Data_Holder[IMU_ID].ay_offset += IMU_Data_Holder[IMU_ID].ay;
                        IMU_Data_Holder[IMU_ID].az_offset += IMU_Data_Holder[IMU_ID].az;
                        //The offset terms should accumilate
                }
        }
        //Now that the requsite samples are collected, average the offsets
        
        IMU_Data_Holder[IMU_ID].ax_offset = IMU_Data_Holder[IMU_ID].ax_offset/((float)sample_count);
        IMU_Data_Holder[IMU_ID].ay_offset = IMU_Data_Holder[IMU_ID].ay_offset/((float)sample_count);
        IMU_Data_Holder[IMU_ID].az_offset = IMU_Data_Holder[IMU_ID].az_offset/((float)sample_count);
        IMU_Data_Holder[IMU_ID].az_offset = IMU_Data_Holder[IMU_ID].az_offset - 9.81;//Subtract actual gravity 
        Serial.printf("IMU %d accel offsets: x: %.4f, y: %.4f, z: %.4f\n", IMU_ID, IMU_Data_Holder[IMU_ID].ax_offset,IMU_Data_Holder[IMU_ID].ay_offset,IMU_Data_Holder[IMU_ID].az_offset);    

        Serial.println("Calibration complete! Input above values in initmpu6050's case statement. The code will now stall. Remove line to calibrate accel to operate normally");

        while(1){

        }
 }